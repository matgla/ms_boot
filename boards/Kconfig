## boards/Kconfig
```kconfig
# This file is part of ms_boot project.
# Copyright (C) 2021 Mateusz Stadnik
#
# This program is free software: you can redistribute it and/or modify
# it under the terms of the GNU General Public License as published by
# the Free Software Foundation, either version 3 of the License, or
# (at your option) any later version.
#
# This program is distributed in the hope that it will be useful,
# but WITHOUT ANY WARRANTY; without even the implied warranty of
# MERCHANTABILITY or FITNESS FOR A PARTICULAR PURPOSE.  See the
# GNU General Public License for more details.
#
# You should have received a copy of the GNU General Public License
# along with this program.  If not, see <https://www.gnu.org/licenses/>.

menu "Hardware Platform configuration"

choice
    prompt "MCU Family: "
    default FAMILY_RASPBERRY_PICO

    config FAMILY_RASPBERRY_PICO
    bool "Raspberry PICO"
    help
        Enable support for Raspberry PICO.

endchoice

config BOARD
    string

choice
    prompt "Board Selection"

source "$(BOARD_DIR)/*.kconfig"

endchoice

source "$(BOARD_DIR)/*.defaults"

endmenu
```
